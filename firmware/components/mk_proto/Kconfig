## firmware/components/mk_proto/Kconfig
```kconfig
menu "MouseKey"

    config MK_CHANNEL
        int "Wi-Fi channel used by ESP-NOW"
        range 1 13
        default 1
        help
            Hub and every dongle must use the same channel.

    config MK_DEVICE_ID
        int "Dongle device id (must match the PC target id)"
        range 1 254
        default 1

endmenu
```

## firmware/dongle/sdkconfig.defaults
```kconfig
CONFIG_IDF_TARGET="esp32s3"

# 使用 UART 作为日志口，原生 USB 口留给 TinyUSB HID
CONFIG_ESP_CONSOLE_UART_DEFAULT=y
CONFIG_ESP_CONSOLE_USB_SERIAL_JTAG=n

CONFIG_TINYUSB_HID_COUNT=1
CONFIG_TINYUSB_CDC_ENABLED=n

CONFIG_PARTITION_TABLE_SINGLE_APP_LARGE=y
CONFIG_COMPILER_OPTIMIZATION_PERF=y
```

## firmware/hub/sdkconfig.defaults
```kconfig
CONFIG_IDF_TARGET="esp32s3"

# 使用 UART 作为日志口，原生 USB 口留给 TinyUSB CDC
CONFIG_ESP_CONSOLE_UART_DEFAULT=y
CONFIG_ESP_CONSOLE_USB_SERIAL_JTAG=n

CONFIG_TINYUSB_CDC_ENABLED=y
CONFIG_TINYUSB_CDC_COUNT=1
CONFIG_TINYUSB_HID_COUNT=0

CONFIG_PARTITION_TABLE_SINGLE_APP_LARGE=y
CONFIG_COMPILER_OPTIMIZATION_PERF=y
```
